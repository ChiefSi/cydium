## src/components/buildinfo/Kconfig
```kconfig
menu "Product name and version"

    config CYD_PRODUCT_NAME
        string "Product name"
        default "cydium"
        help
            Shown at the top of the menu's About page.

    choice CYD_VERSION_SOURCE
        prompt "Version"
        default CYD_VERSION_GENERATED
        help
            Shown on the menu's About page.

        config CYD_VERSION_GENERATED
            bool "Generated: git describe and build time"
            help
                "<git describe>[-dirty]-<build time>", with the build time in
                seconds since the Unix epoch (UTC), e.g.
                "7973efb-dirty-1795189980". build.sh passes the git
                part in (the container has no .git); -dirty is added when
                `git status --porcelain` reports any change, including
                untracked files. Without build.sh it reads "unknown".

        config CYD_VERSION_CUSTOM
            bool "Custom string"
    endchoice

    config CYD_VERSION_STRING
        string "Custom version"
        depends on CYD_VERSION_CUSTOM
        default "custom"

endmenu
```

## src/components/display/Kconfig
```kconfig
menu "CYD display"

    config CYD_LCD_PCLK_MHZ
        int "SPI pixel clock (MHz)"
        range 10 80
        default 40
        help
            Start at 40 MHz. The TFT is on HSPI's IO_MUX pins, so 60-80 MHz
            may work; keep the fastest clock that is stable on your board.

    config CYD_LCD_BGR
        bool "Panel uses BGR element order"
        default n
        help
            Leave off if red and blue come out right. Turn on if they are
            swapped (some CYD batches are wired BGR).

    config CYD_LCD_INVERT_DEFAULT
        bool "Invert colours by default"
        default n
        help
            Panels vary between CYD clones. If dark scenes look bright and
            washed out, flip this. It is the default for the Invert colours
            setting in Settings > Display, which is saved in NVS.

    config CYD_LCD_SWAP_XY
        bool "Swap X and Y"
        default y
        help
            On this CYD the controller's column address runs along the 320 px
            edge. Swapping gives the 240x320 portrait address space the
            firmware expects; without it the last 80 columns are never written.

    config CYD_LCD_MIRROR_X
        bool "Mirror X"
        default y
        help
            With swap and both mirrors on, (0, 0) is top-left in portrait with
            the USB port at the bottom. Flip if the image is mirrored
            left-right.

    config CYD_LCD_MIRROR_Y
        bool "Mirror Y"
        default y
        help
            Flip if the image is upside down (text reflected vertically).

    choice CYD_DISPLAY_LANDSCAPE_DIR
        prompt "Landscape direction"
        default CYD_DISPLAY_LANDSCAPE_USB_RIGHT
        help
            Which way the screen turns when the orientation setting is
            Landscape, relative to portrait with the USB port at the bottom.

        config CYD_DISPLAY_LANDSCAPE_USB_RIGHT
            bool "USB on the right (rotated anticlockwise)"
        config CYD_DISPLAY_LANDSCAPE_USB_LEFT
            bool "USB on the left (rotated clockwise)"
    endchoice

    choice CYD_DISPLAY_ORIENTATION_DEFAULT
        prompt "Default orientation"
        default CYD_DISPLAY_DEFAULT_PORTRAIT
        help
            Orientation used until it is changed in Settings > Display (the
            choice is then saved in NVS).

        config CYD_DISPLAY_DEFAULT_PORTRAIT
            bool "Portrait"
        config CYD_DISPLAY_DEFAULT_LANDSCAPE
            bool "Landscape"
    endchoice

    config CYD_LCD_PROBE
        bool "Log controller ID registers at boot"
        default n
        help
            Reads the LCD controller's ID registers over MISO before
            initialising the panel and logs them. Used by the diagnostic image.

endmenu
```

## src/components/touch/Kconfig
```kconfig
menu "CYD touch"

    comment "Raw XPT2046 readings (0-4095) at the screen edges, in portrait."
    comment "Defaults calibrated on a CYD; re-run with the diagnostic image."

    config CYD_TOUCH_X_MIN
        int "Raw X minimum"
        range 0 4095
        default 261

    config CYD_TOUCH_X_MAX
        int "Raw X maximum"
        range 0 4095
        default 3843

    config CYD_TOUCH_Y_MIN
        int "Raw Y minimum"
        range 0 4095
        default 196

    config CYD_TOUCH_Y_MAX
        int "Raw Y maximum"
        range 0 4095
        default 3847

    config CYD_TOUCH_SWAP_XY
        bool "Raw X measures the screen's vertical axis"
        default n
        help
            Turn on if raw X changes when moving up and down the portrait
            screen (along the long, 320 px edge) rather than across it.

    config CYD_TOUCH_FLIP_X
        bool "Flip screen X"
        default y
        help
            Turn on if, in portrait, touches on the left register on the right.

    config CYD_TOUCH_FLIP_Y
        bool "Flip screen Y"
        default n
        help
            Turn on if, in portrait, touches at the top register at the bottom.

endmenu
```

## src/components/ui/Kconfig
```kconfig
menu "CYD menu"

    config CYD_MENU_ICON_SIZE
        int "Menu icon size (pixels)"
        range 16 64
        default 32
        help
            Width and height of the menu icon. The PNG is scaled to fit this
            square at build time. Resistive touch needs a target of about
            30 px or more.

    config CYD_MENU_ICON_OFFSET
        int "Menu icon offset from the screen edges (pixels)"
        range 0 64
        default 4

    config CYD_MENU_ICON_PNG
        string "Menu icon PNG"
        default "icons/menu.png"
        help
            Path to the icon image, relative to src/components/ui (or
            absolute inside the build container). It must live under src/,
            the only folder the container build can see. Non-interlaced
            8-bit grey, RGB, RGBA or palette PNGs are supported; transparency
            is kept. Regenerate the default with tools/make_menu_icon.py.

    choice CYD_MENU_ICON_CORNER
        prompt "Default menu icon position"
        default CYD_MENU_ICON_TOP_LEFT
        help
            Used until the icon is moved in Settings > Display (the choice is
            then saved in NVS).

        config CYD_MENU_ICON_TOP_LEFT
            bool "Top left"
        config CYD_MENU_ICON_TOP_RIGHT
            bool "Top right"
        config CYD_MENU_ICON_BOTTOM_LEFT
            bool "Bottom left"
        config CYD_MENU_ICON_BOTTOM_RIGHT
            bool "Bottom right"
    endchoice

    config CYD_MENU_TIMEOUT_S
        int "Close the menu after this many seconds without a touch (0 = never)"
        range 0 600
        default 10

endmenu
```
